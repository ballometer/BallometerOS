## buildroot-external/Config.in
```kconfig
source "$BR2_EXTERNAL_BALLOMETER_PATH/package/influxdb/Config.in"
source "$BR2_EXTERNAL_BALLOMETER_PATH/package/python-adafruit-blinka/Config.in"
source "$BR2_EXTERNAL_BALLOMETER_PATH/package/python-adafruit-circuitpython-bmp280/Config.in"
source "$BR2_EXTERNAL_BALLOMETER_PATH/package/python-adafruit-circuitpython-busdevice/Config.in"
source "$BR2_EXTERNAL_BALLOMETER_PATH/package/python-adafruit-circuitpython-gps/Config.in"
source "$BR2_EXTERNAL_BALLOMETER_PATH/package/python-adafruit-circuitpython-lsm303-accel/Config.in"
source "$BR2_EXTERNAL_BALLOMETER_PATH/package/python-adafruit-circuitpython-lsm303dlh-mag/Config.in"
source "$BR2_EXTERNAL_BALLOMETER_PATH/package/python-adafruit-circuitpython-register/Config.in"
source "$BR2_EXTERNAL_BALLOMETER_PATH/package/python-adafruit-circuitpython-sht31d/Config.in"
source "$BR2_EXTERNAL_BALLOMETER_PATH/package/python-adafruit-circuitpython-tsl2591/Config.in"
source "$BR2_EXTERNAL_BALLOMETER_PATH/package/python-adafruit-platformdetect/Config.in"
source "$BR2_EXTERNAL_BALLOMETER_PATH/package/python-adafruit-pureio/Config.in"
source "$BR2_EXTERNAL_BALLOMETER_PATH/package/python-fastapi/Config.in"
source "$BR2_EXTERNAL_BALLOMETER_PATH/package/python-h11/Config.in"
source "$BR2_EXTERNAL_BALLOMETER_PATH/package/python-pynmea2/Config.in"
source "$BR2_EXTERNAL_BALLOMETER_PATH/package/python-pyserial/Config.in"
source "$BR2_EXTERNAL_BALLOMETER_PATH/package/python-rplcd/Config.in"
source "$BR2_EXTERNAL_BALLOMETER_PATH/package/python-smbus2/Config.in"
source "$BR2_EXTERNAL_BALLOMETER_PATH/package/python-starlette/Config.in"
source "$BR2_EXTERNAL_BALLOMETER_PATH/package/python-uvicorn/Config.in"
```

## buildroot-external/configs/ballometer_defconfig
```kconfig
# based on raspberrypi3_defconfig

BR2_arm=y
BR2_cortex_a53=y
BR2_ARM_FPU_NEON_VFPV4=y

BR2_TOOLCHAIN_BUILDROOT_WCHAR=y
BR2_TOOLCHAIN_BUILDROOT_CXX=y

BR2_SYSTEM_DHCP="eth0"

# Linux headers same as kernel, a 5.10 series
BR2_PACKAGE_HOST_LINUX_HEADERS_CUSTOM_5_10=y

BR2_LINUX_KERNEL=y
BR2_LINUX_KERNEL_CUSTOM_TARBALL=y
BR2_LINUX_KERNEL_CUSTOM_TARBALL_LOCATION="$(call github,raspberrypi,linux,4afd064509b23882268922824edc5b391a1ea55d)/linux-4afd064509b23882268922824edc5b391a1ea55d.tar.gz"
BR2_LINUX_KERNEL_DEFCONFIG="bcm2709"
BR2_LINUX_KERNEL_DTS_SUPPORT=y
BR2_LINUX_KERNEL_INTREE_DTS_NAME="bcm2710-rpi-3-b bcm2710-rpi-3-b-plus bcm2710-rpi-cm3"
BR2_LINUX_KERNEL_NEEDS_HOST_OPENSSL=y

# Packages
BR2_PACKAGE_BLUEZ_TOOLS=y
BR2_PACKAGE_BLUEZ5_UTILS_CLIENT=y
BR2_PACKAGE_BLUEZ5_UTILS_DEPRECATED=y
BR2_PACKAGE_BLUEZ5_UTILS=y
BR2_PACKAGE_CA_CERTIFICATES=y
BR2_PACKAGE_DHCPCD=y
BR2_PACKAGE_E2FSPROGS_RESIZE2FS=y
BR2_PACKAGE_E2FSPROGS=y
BR2_PACKAGE_INFLUXDB=y
BR2_PACKAGE_LIBCURL=y
BR2_PACKAGE_NGINX=y
BR2_PACKAGE_NODEJS_MODULES_ADDITIONAL="tileserver-gl-light"
BR2_PACKAGE_NODEJS=y
BR2_PACKAGE_NTP=y
BR2_PACKAGE_OPENSSH=y
BR2_PACKAGE_PYTHON_ADAFRUIT_CIRCUITPYTHON_BMP280=y
BR2_PACKAGE_PYTHON_ADAFRUIT_CIRCUITPYTHON_GPS=y
BR2_PACKAGE_PYTHON_ADAFRUIT_CIRCUITPYTHON_LSM303_ACCEL=y
BR2_PACKAGE_PYTHON_ADAFRUIT_CIRCUITPYTHON_LSM303DLH_MAG=y
BR2_PACKAGE_PYTHON_ADAFRUIT_CIRCUITPYTHON_SHT31D=y
BR2_PACKAGE_PYTHON_ADAFRUIT_CIRCUITPYTHON_TSL2591=y
BR2_PACKAGE_PYTHON_ALSAAUDIO=y
BR2_PACKAGE_PYTHON_FASTAPI=y
BR2_PACKAGE_PYTHON_INFLUXDB=y
BR2_PACKAGE_PYTHON_PYNMEA2=y
BR2_PACKAGE_PYTHON_REDIS=y
BR2_PACKAGE_PYTHON_RPI_GPIO_64=y
BR2_PACKAGE_PYTHON_RPLCD=y
BR2_PACKAGE_PYTHON_SMBUS2=y
BR2_PACKAGE_PYTHON_UVICORN=y
BR2_PACKAGE_PYTHON3=y
BR2_PACKAGE_REDIS=y
BR2_PACKAGE_RPI_BT_FIRMWARE=y
BR2_PACKAGE_RPI_FIRMWARE=y
BR2_PACKAGE_RPI_WIFI_FIRMWARE=y
BR2_PACKAGE_WPA_SUPPLICANT_AUTOSCAN=y
BR2_PACKAGE_WPA_SUPPLICANT_CLI=y
BR2_PACKAGE_WPA_SUPPLICANT_WPA_CLIENT_SO=y
BR2_PACKAGE_WPA_SUPPLICANT=y
BR2_PACKAGE_ZSH=y

# Required tools to create the SD image
BR2_PACKAGE_HOST_DOSFSTOOLS=y
BR2_PACKAGE_HOST_GENIMAGE=y
BR2_PACKAGE_HOST_MTOOLS=y
BR2_PACKAGE_HOST_PYTHON3=y
BR2_PACKAGE_HOST_PYTHON3_SSL=y

# Filesystem / image
BR2_TARGET_ROOTFS_EXT2=y
BR2_TARGET_ROOTFS_EXT2_4=y
BR2_TARGET_ROOTFS_EXT2_SIZE="350M"
BR2_TARGET_GENERIC_HOSTNAME="ballometer"
BR2_TARGET_GENERIC_ISSUE="Welcome to the ballometer"
BR2_TARGET_GENERIC_ROOT_PASSWD="hello"

# BR2_TARGET_ROOTFS_TAR is not set
BR2_ROOTFS_POST_BUILD_SCRIPT="board/raspberrypi3/post-build.sh"
BR2_ROOTFS_POST_IMAGE_SCRIPT="board/raspberrypi3/post-image.sh"
BR2_ROOTFS_POST_SCRIPT_ARGS="--add-miniuart-bt-overlay"
```

## buildroot-external/package/influxdb/Config.in
```kconfig
config BR2_PACKAGE_INFLUXDB
    bool "influxdb"
    help
        InfluxDB is an open source time series platform.
```

## buildroot-external/package/python-adafruit-circuitpython-bmp280/Config.in
```kconfig
config BR2_PACKAGE_PYTHON_ADAFRUIT_CIRCUITPYTHON_BMP280
	bool "python-adafruit-circuitpython-bmp280"
	select BR2_PACKAGE_PYTHON_ADAFRUIT_BLINKA # runtime
	select BR2_PACKAGE_PYTHON_ADAFRUIT_CIRCUITPYTHON_BUSDEVICE # runtime
	help
	  CircuitPython driver for the BMP280.

	  https://github.com/adafruit/Adafruit_CircuitPython_BMP280
```

## buildroot-external/package/python-adafruit-circuitpython-busdevice/Config.in
```kconfig
config BR2_PACKAGE_PYTHON_ADAFRUIT_CIRCUITPYTHON_BUSDEVICE
	bool "python-adafruit-circuitpython-busdevice"
	select BR2_PACKAGE_PYTHON_ADAFRUIT_BLINKA # runtime
	help
	  CircuitPython bus device classes to manage bus sharing.

	  https://github.com/adafruit/Adafruit_CircuitPython_BusDevice
```

## buildroot-external/package/python-adafruit-circuitpython-gps/Config.in
```kconfig
config BR2_PACKAGE_PYTHON_ADAFRUIT_CIRCUITPYTHON_GPS
	bool "python-adafruit-circuitpython-gps"
	select BR2_PACKAGE_PYTHON_PYSERIAL # runtime
	select BR2_PACKAGE_PYTHON_ADAFRUIT_BLINKA # runtime
	select BR2_PACKAGE_PYTHON_ADAFRUIT_CIRCUITPYTHON_BUSDEVICE # runtime
	help
	  CircuitPython library for GPS modules.

	  https://github.com/adafruit/Adafruit_CircuitPython_GPS
```

## buildroot-external/package/python-adafruit-circuitpython-lsm303-accel/Config.in
```kconfig
config BR2_PACKAGE_PYTHON_ADAFRUIT_CIRCUITPYTHON_LSM303_ACCEL
	bool "python-adafruit-circuitpython-lsm303-accel"
	select BR2_PACKAGE_PYTHON_ADAFRUIT_BLINKA # runtime
	select BR2_PACKAGE_PYTHON_ADAFRUIT_CIRCUITPYTHON_BUSDEVICE # runtime
	select BR2_PACKAGE_PYTHON_ADAFRUIT_CIRCUITPYTHON_REGISTER # runtime
	help
	  CircuitPython library for LSM303 's 3-axis accelerometer.

	  https://github.com/adafruit/Adafruit_CircuitPython_LSM303_Accel
```

## buildroot-external/package/python-adafruit-circuitpython-lsm303dlh-mag/Config.in
```kconfig
config BR2_PACKAGE_PYTHON_ADAFRUIT_CIRCUITPYTHON_LSM303DLH_MAG
	bool "python-adafruit-circuitpython-lsm303dlh-mag"
	select BR2_PACKAGE_PYTHON_ADAFRUIT_BLINKA # runtime
	select BR2_PACKAGE_PYTHON_ADAFRUIT_CIRCUITPYTHON_BUSDEVICE # runtime
	help
	  CircuitPython library for LSM303DLH's 3-axis magnetometer.

	  https://github.com/adafruit/Adafruit_CircuitPython_LSM303DLH_Mag
```

## buildroot-external/package/python-adafruit-circuitpython-register/Config.in
```kconfig
config BR2_PACKAGE_PYTHON_ADAFRUIT_CIRCUITPYTHON_REGISTER
	bool "python-adafruit-circuitpython-register"
	help
	  CircuitPython data descriptor classes to represent hardware
	  registers on I2C and SPI devices.

	  https://github.com/adafruit/Adafruit_CircuitPython_Register
```

## buildroot-external/package/python-adafruit-circuitpython-sht31d/Config.in
```kconfig
config BR2_PACKAGE_PYTHON_ADAFRUIT_CIRCUITPYTHON_SHT31D
	bool "python-adafruit-circuitpython-sht31d"
	select BR2_PACKAGE_PYTHON_ADAFRUIT_BLINKA # runtime
	select BR2_PACKAGE_PYTHON_ADAFRUIT_CIRCUITPYTHON_BUSDEVICE # runtime
	help
	  CircuitPython library for SHT31-D temperature and humidity sensor.

	  https://github.com/adafruit/Adafruit_CircuitPython_SHT31-D
```

## buildroot-external/package/python-adafruit-circuitpython-tsl2591/Config.in
```kconfig
config BR2_PACKAGE_PYTHON_ADAFRUIT_CIRCUITPYTHON_TSL2591
	bool "python-adafruit-circuitpython-tsl2591"
	select BR2_PACKAGE_PYTHON_ADAFRUIT_BLINKA # runtime
	select BR2_PACKAGE_PYTHON_ADAFRUIT_CIRCUITPYTHON_BUSDEVICE # runtime
	help
	  CircuitPython library for TSL2591 high precision light sensor.

	  https://github.com/adafruit/Adafruit_CircuitPython_TSL2591
```

## buildroot-external/package/python-pynmea2/Config.in
```kconfig
config BR2_PACKAGE_PYTHON_PYNMEA2
	bool "python-pynmea2"
	help
	  Python library for the NMEA 0183 protcol.

	  https://github.com/Knio/pynmea2
```

## buildroot-external/package/python-rplcd/Config.in
```kconfig
config BR2_PACKAGE_PYTHON_RPLCD
	bool "python-rplcd"
	help
	  A Raspberry Pi LCD library for the widely used Hitachi
	  HD44780 controller.

	  https://github.com/dbrgn/RPLCD
```
